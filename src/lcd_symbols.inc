
_POINT	EQU	H'2E'
_COMMA	EQU	H'2C'
_SPACE	EQU	H'20'
_EQUAL	EQU	H'3D'
_PLUS	EQU	H'2B'
_MINUS	EQU	H'2D'
_QUEST	EQU	H'3F'
_AND	EQU	H'26'
_PERCENT	EQU	H'25'
_NUMBER	EQU	H'23'
_SLASH	EQU	H'2F'
_ARROW_UP	EQU H'D9'
_ARROW_DOWN	EQU H'DA'
_LOWER		EQU H'3C'
_GREATER	EQU H'3E'
;************************
_A	EQU	H'41'
_B	EQU	H'42'
_C	EQU	H'43'
_D	EQU	H'44'
_E	EQU	H'45'
_F	EQU	H'46'
_G	EQU	H'47'
_H	EQU	H'48'
_I	EQU	H'49'
_J	EQU	H'4A'
_K	EQU	H'4B'
_L	EQU	H'4C'
_M	EQU	H'4D'
_N	EQU	H'4E'
_O	EQU	H'4F'
_P	EQU	H'50'
_Q	EQU	H'51'
_R	EQU	H'52'
_S	EQU	H'53'
_T	EQU	H'54'
_U	EQU	H'55'
_V	EQU	H'56'
_W	EQU	H'57'
_X	EQU	H'58'
_Y	EQU	H'59'
_Z	EQU	H'5A'
;************************
_a	EQU	H'61'
_b	EQU	H'62'
_c	EQU	H'63'
_d	EQU	H'64'
_e	EQU	H'65'
_f	EQU	H'66'
_g	EQU	H'67'
_h	EQU	H'68'
_i	EQU	H'69'
_j	EQU	H'6A'
_k	EQU	H'6B'
_l	EQU	H'6C'
_m	EQU	H'6D'
_n	EQU	H'6E'
_o	EQU	H'6F'
_p	EQU	H'70'
_q	EQU	H'71'
_r	EQU	H'72'
_s	EQU	H'73'
_t	EQU	H'74'
_u	EQU	H'75'
_v	EQU	H'76'
_w	EQU	H'77'
_x	EQU	H'78'
_y	EQU	H'79'
_z	EQU	H'7A'
;************************
А	EQU	H'41'
Б	EQU	H'A0'
В	EQU	H'42'
Г	EQU	H'A1'
Д	EQU	H'E0'
Е	EQU	H'45'
Ё	EQU	H'A2'
Ж	EQU	H'A3'
З	EQU	H'A4'
И	EQU	H'A5'
Й	EQU	H'A6'
К	EQU	H'4B'
Л	EQU	H'A7'
М	EQU	H'4D'
Н	EQU	H'48'
О	EQU	H'4F'
П	EQU	H'A8'
Р	EQU	H'50'
С	EQU	H'43'
Т	EQU	H'54'
У	EQU	H'A9'
Ф	EQU	H'AA'
Х	EQU	H'58'
Ц	EQU	H'E1'
Ч	EQU	H'AB'
Ш	EQU	H'AC'
Щ	EQU	H'E2'
Ъ	EQU	H'AD'
Ы	EQU	H'AE'
Ь	EQU	H'62'
Э	EQU	H'AF'
Ю	EQU	H'B0'
Я	EQU	H'B1'
;************************
а	EQU	H'61'
б	EQU	H'B2'
в	EQU	H'B3'
г	EQU	H'B4'
д	EQU	H'E3'
е	EQU	H'65'
ё	EQU	H'B5'
ж	EQU	H'B6'
з	EQU	H'B7'
и	EQU	H'B8'
й	EQU	H'B9'
к	EQU	H'BA'
л	EQU	H'BB'
м	EQU	H'BC'
н	EQU	H'BD'
о	EQU	H'6F'
п	EQU	H'BE'
р	EQU	H'70'
с	EQU	H'63'
т	EQU	H'BF'
у	EQU	H'79'
ф	EQU	H'E4'
х	EQU	H'78'
ц	EQU	H'E5'
ч	EQU	H'C0'
ш	EQU	H'C1'
щ	EQU	H'E6'
ъ	EQU	H'C2'
ы	EQU	H'C3'
ь	EQU	H'C4'
э	EQU	H'C5'
ю	EQU	H'C6'
zz	EQU	H'C7'
;************************
;   FOR VLI  ************************
А_	EQU	H'41'
Б_	EQU	H'80'
В_	EQU	H'42'
Г_	EQU	H'92'
Д_	EQU	H'81'
Е_	EQU	H'45'
Ё_	EQU	H'CB'
Ж_	EQU	H'82'
З_	EQU	H'83'
И_	EQU	H'84'
Й_	EQU	H'85'
К_	EQU	H'4B'
Л_	EQU	H'86'
М_	EQU	H'4D'
Н_	EQU	H'48'
О_	EQU	H'4F'
П_	EQU	H'87'
Р_	EQU	H'50'
С_	EQU	H'43'
Т_	EQU	H'54'
У_	EQU	H'88'
Ф_	EQU	H'A2'
Х_	EQU	H'58'
Ц_	EQU	H'89'
Ч_	EQU	H'8A'
Ш_	EQU	H'8B'
Щ_	EQU	H'8C'
Ъ_	EQU	H'8D'
Ы_	EQU	H'8E'
Ь_	EQU	H'62'
Э_	EQU	H'8F'
Ю_	EQU	H'AC'
Я_	EQU	H'AD'
;************************
а_	EQU	H'61'
б_	EQU	H'9B'
в_	EQU	H'DF'
г_	EQU	H'72'
д_	EQU	H'67'
е_	EQU	H'65'
ё_	EQU	H'EB'
ж_	EQU	H'2A'
и_	EQU	H'75'
й_	EQU	H'FA'
к_	EQU	H'6B'
л_	EQU	H'93'
о_	EQU	H'6F'
п_	EQU	H'6E'
р_	EQU	H'70'
с_	EQU	H'63'
т_	EQU	H'6D'
у_	EQU	H'79'
ф_	EQU	H'D8'
х_	EQU	H'78'
;************************

; custom chars
_kmh0	EQU	0x00
_kmh1	EQU	0x01
_omin0	EQU	0x02
_omin1	EQU	0x03
_lkm0	EQU 0x04
_lkm1	EQU 0x05
_lh0	EQU	0x06
_lh1	EQU	0x07